## config/west.yml
```yaml
manifest:
  remotes:
    - name: zmkfirmware
      url-base: https://github.com/zmkfirmware
    - name: Crush53
      url-base: https://github.com/Crush53
  projects:
    - name: zmk
      remote: zmkfirmware
      revision: main
      import: app/west.yml
    - name: zmk-keyboards
      remote: Crush53
      revision: zephyr-4.1-fix
      import: config/west.yml
    - name: zmk-pmw3610-driver
      remote: Crush53
      revision: startup_optimization
  self:
    path: config
```
